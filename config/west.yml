## config/west.yml
```yaml
manifest:
  remotes:
    - name: zmkfirmware
      # url-base: https://github.com/zmkfirmware
      url-base: https://github.com/petejohanson
  projects:
    - name: zmk
      remote: zmkfirmware
      # revision: main
      revision: core/peripheral-behavior-invocation
      import: app/west.yml
  self:
    path: config
```
